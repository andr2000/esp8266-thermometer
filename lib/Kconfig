## lib/Kconfig
```kconfig
config WIFI
	tristate

menu "WiFi settings"
config WIFI_SSID
	string "WiFi SSID"
	depends on WIFI

config WIFI_PWD
	string "WiFi password"
	depends on WIFI
endmenu

config RBOOT_OTA
	tristate

menu "RBoot OTA settings"
config RBOOT_OTA_HOST
	string "rboot OTA host"
	depends on RBOOT_OTA

config RBOOT_OTA_PORT
	int "rboot OTA port"
	default "80"
	depends on RBOOT_OTA
endmenu

config MQTT
	tristate

menu "MQTT settings"
config MQTT_USER
	string "MQTT user ID"
	depends on MQTT

config MQTT_PWD
	string "MQTT password"
	depends on MQTT

config MQTT_HOST
	string "MQTT host"
	depends on MQTT

config MQTT_PORT
	int "MQTT port"
	default "1883"
	depends on MQTT
endmenu
```

## thermometer/Kconfig
```kconfig
config THERMOMETER_DS18B20
	tristate "Thermometer thing with DS18b20"
	select WIFI
	select RBOOT_OTA
```

## thing/Kconfig
```kconfig
menu "SPI settings"
choice
	prompt "Flash size"
	default SPI_SIZE_1MIB

config SPI_SIZE_1MIB
	bool "1 MiB"

config SPI_SIZE_4MIB
	bool "4 MiB"

endchoice

choice
	prompt "Speed"
	default SPI_SPEED_40MHZ

config SPI_SPEED_20MHZ
	bool "20 MHz"

config SPI_SPEED_26_7MHZ
	bool "26.7 MHz"

config SPI_SPEED_40MHZ
	bool "40 MHz"

config SPI_SPEED_80MHZ
	bool "80 MHz"

endchoice

choice
	prompt "Mode"
	default SPI_MODE_QIO

config SPI_MODE_QIO
	bool "Quad I/O: 4 pins used for address & data. Fastest."

config SPI_MODE_DIO
	bool "Dual I/O: 2 pins used for address & data. Approx 45% slower than qio."

config SPI_MODE_QOUT
	bool "Quad Output: 4 pins used for data. Approx 15% slower than qio."

config SPI_MODE_DOUT
	bool "Dual Output: 2 pins used for data. Approx 50% slower than qio."

endchoice

endmenu

config DEBUG
	bool "Enable log functions"
	default y
	help
	  Say Y if you want to enable logging.
	  If you say N here, logging is not compiled.

config LOGLEVEL
        int "Default message log level (1-4)"
        range 1 4
        default "3"
	depends on DEBUG
        help
          Default priority level for log functions.
	  Depending on this variable, each of log functions
	  output log messages to the console, or just return
	  without doing anything.

	  LOGLEVEL     err       warn        info        debug
	     1          o          x           x           x
	     2          o          o           x           x
	     3          o          o           o           x
	     4          o          o           o           o

	  here, o: output log messages
	        x: do nothing
```
